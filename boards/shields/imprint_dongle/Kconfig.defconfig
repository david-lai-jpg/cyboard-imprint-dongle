## boards/shields/imprint_dongle/Kconfig.defconfig
```kconfig
if SHIELD_IMPRINT_DONGLE

config ZMK_KEYBOARD_NAME
    default "Imprint"

config ZMK_SPLIT_ROLE_CENTRAL
    default y

config ZMK_SPLIT_BLE_CENTRAL_PERIPHERALS
    default 2

config BT_MAX_CONN
    default 7

config BT_MAX_PAIRED
    default 7

config ZMK_SPLIT_BLE_CENTRAL_BATTERY_LEVEL_FETCHING
    default y

if ZMK_DISPLAY

config I2C
    default y

config SSD1306
    default y

choice ZMK_DISPLAY_WORK_QUEUE
    default ZMK_DISPLAY_WORK_QUEUE_DEDICATED
endchoice

endif # ZMK_DISPLAY

if SSD1306

config LV_Z_VDB_SIZE
    default 64

config LV_DPI_DEF
    default 148

config LV_Z_BITS_PER_PIXEL
    default 1

choice LV_COLOR_DEPTH
    default LV_COLOR_DEPTH_1
endchoice

endif # SSD1306

endif # SHIELD_IMPRINT_DONGLE

# Use "default y if X" syntax (NOT if/endif blocks) for configs that ZMK core
# also manages. if/endif blocks add "depends on" which poisons global deps.
config ZMK_SPLIT
    default y if (SHIELD_IMPRINT_DONGLE || SHIELD_IMPRINT_DONGLE_LEFT || SHIELD_IMPRINT_DONGLE_RIGHT)

config ZMK_POINTING
    default y if (SHIELD_IMPRINT_DONGLE || SHIELD_IMPRINT_DONGLE_LEFT || SHIELD_IMPRINT_DONGLE_RIGHT)

if SHIELD_IMPRINT_DONGLE_LEFT || SHIELD_IMPRINT_DONGLE_RIGHT

config ZMK_SLEEP
    default y

config ZMK_POINTING_SMOOTH_SCROLLING
    default n

config SPI
    default y

config PMW3610
    default y

config PMW3610_SWAP_XY
    default y

config PMW3610_REPORT_INTERVAL_MIN
    default 8

config ZMK_RGB_UNDERGLOW
    default y

config ZMK_RGB_UNDERGLOW_ON_START
    default n

config ZMK_RGB_UNDERGLOW_BRT_MIN
    default 5

config ZMK_RGB_UNDERGLOW_BRT_MAX
    default 50

config ZMK_RGB_UNDERGLOW_BRT_START
    default 25

config ZMK_RGB_UNDERGLOW_BRT_STEP
    default 5

config ZMK_RGB_UNDERGLOW_HUE_START
    default 40

endif # left or right peripheral
```

## boards/shields/imprint_dongle/Kconfig.shield
```kconfig
config SHIELD_IMPRINT_DONGLE
    def_bool $(shields_list_contains,imprint_dongle)

config SHIELD_IMPRINT_DONGLE_LEFT
    def_bool $(shields_list_contains,imprint_dongle_left)

config SHIELD_IMPRINT_DONGLE_RIGHT
    def_bool $(shields_list_contains,imprint_dongle_right)
```

## boards/shields/settings_reset_peripheral/Kconfig.defconfig
```kconfig
# Copyright (c) 2024 The ZMK Contributors
# SPDX-License-Identifier: MIT

if SHIELD_SETTINGS_RESET_PERIPHERAL

config ZMK_KEYBOARD_NAME
    default "SETTINGS RESET"

endif
```

## boards/shields/settings_reset_peripheral/Kconfig.shield
```kconfig
# Copyright (c) 2024 The ZMK Contributors
# SPDX-License-Identifier: MIT

config SHIELD_SETTINGS_RESET_PERIPHERAL
    def_bool $(shields_list_contains,settings_reset_peripheral)
```

## config/west.yml
```yaml
manifest:
  remotes:
    - name: zmkfirmware
      url-base: https://github.com/zmkfirmware
    - name: Cyboard-DigitalTailor
      url-base: https://github.com/Cyboard-DigitalTailor
    - name: david-lai-jpg
      url-base: https://github.com/david-lai-jpg
  projects:
    - name: zmk
      remote: zmkfirmware
      revision: v0.3.0
      import: app/west.yml
    - name: zmk-keyboards
      remote: Cyboard-DigitalTailor
      revision: studio-support
      import: config/west.yml
    - name: zmk-acceleration-curves
      remote: david-lai-jpg
      revision: default-curve
  self:
    path: config
```
